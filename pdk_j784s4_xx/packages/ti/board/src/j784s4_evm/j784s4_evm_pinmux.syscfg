/**
 * @cliArgs --device "J784S4_TDA4AP_TDA4VP_TDA4AH_TDA4VH" --package "ALY" --part "Default"
 * @versions {"tool":"1.12.1+2446"}
 */

/**
 * These are the peripherals and settings in this configuration
 */
const iAUXPHY1                                    = scripting.addPeripheral("AUXPHY");
iAUXPHY1.$name                                    = "MyAUXPHY";
iAUXPHY1.AUXN.$assign                             = "ball.AP22";
iAUXPHY1.AUXP.$assign                             = "ball.AP23";
const iCPSW2G1                                    = scripting.addPeripheral("CPSW2G");
iCPSW2G1.$name                                    = "MyCPSW2G";
iCPSW2G1.CLKOUT.$used                             = false;
iCPSW2G1.RMII1_CRS_DV.$used                       = false;
iCPSW2G1.MDIO0_MDC.$assign                        = "ball.AD38";
iCPSW2G1.MDIO0_MDIO.$assign                       = "ball.AD33";
iCPSW2G1.RMII_REF_CLK.$used                       = false;
iCPSW2G1.RMII1_RXD0.$used                         = false;
iCPSW2G1.RMII1_RXD1.$used                         = false;
iCPSW2G1.RMII1_RX_ER.$used                        = false;
iCPSW2G1.RMII1_TXD0.$used                         = false;
iCPSW2G1.RMII1_TXD1.$used                         = false;
iCPSW2G1.RMII1_TX_EN.$used                        = false;
iCPSW2G1.RGMII1_RD0.$assign                       = "ball.AC34";
iCPSW2G1.RGMII1_RD1.$assign                       = "ball.AD34";
iCPSW2G1.RGMII1_RD2.$assign                       = "ball.AJ36";
iCPSW2G1.RGMII1_RD3.$assign                       = "ball.AF34";
iCPSW2G1.RGMII1_RXC.$assign                       = "ball.AL33";
iCPSW2G1.RGMII1_RX_CTL.$assign                    = "ball.AE34";
iCPSW2G1.RGMII1_TD0.$assign                       = "ball.AE35";
iCPSW2G1.RGMII1_TD1.$assign                       = "ball.AC35";
iCPSW2G1.RGMII1_TD2.$assign                       = "ball.AG35";
iCPSW2G1.RGMII1_TD3.$assign                       = "ball.AH36";
iCPSW2G1.RGMII1_TXC.$assign                       = "ball.AL34";
iCPSW2G1.RGMII1_TX_CTL.$assign                    = "ball.AF35";
scripting.suppress("Solution may have changed,No suggested solution was provided, so this value may differ from the last time this tool was run", iCPSW2G1, "RGMII1_RXC");
const iCPSW9X1                                    = scripting.addPeripheral("CPSW9X");
iCPSW9X1.$name                                    = "MyCPSW9X";
iCPSW9X1.MDIO1_MDIO.$assign                       = "ball.AC36";
iCPSW9X1.MDIO1_MDC.$assign                        = "ball.AE37";
iCPSW9X1.SGMII1_TXP0.$used                        = false;
iCPSW9X1.SGMII1_TXN0.$used                        = false;
iCPSW9X1.SGMII1_RXP0.$used                        = false;
iCPSW9X1.SGMII1_RXN0.$used                        = false;
iCPSW9X1.SGMII2_TXP0.$used                        = false;
iCPSW9X1.SGMII2_TXN0.$used                        = false;
iCPSW9X1.SGMII2_RXP0.$used                        = false;
iCPSW9X1.SGMII2_RXN0.$used                        = false;
iCPSW9X1.SGMII3_TXP0.$used                        = false;
iCPSW9X1.SGMII3_TXN0.$used                        = false;
iCPSW9X1.SGMII3_RXP0.$used                        = false;
iCPSW9X1.SGMII3_RXN0.$used                        = false;
iCPSW9X1.SGMII4_TXP0.$used                        = false;
iCPSW9X1.SGMII4_TXN0.$used                        = false;
iCPSW9X1.SGMII4_RXP0.$used                        = false;
iCPSW9X1.SGMII4_RXN0.$used                        = false;
iCPSW9X1.SGMII5_TXP0.$used                        = false;
iCPSW9X1.SGMII5_TXN0.$used                        = false;
iCPSW9X1.SGMII5_RXP0.$used                        = false;
iCPSW9X1.SGMII5_RXN0.$used                        = false;
iCPSW9X1.SGMII6_TXP0.$used                        = false;
iCPSW9X1.SGMII6_TXN0.$used                        = false;
iCPSW9X1.SGMII6_RXP0.$used                        = false;
iCPSW9X1.SGMII6_RXN0.$used                        = false;
iCPSW9X1.SGMII7_TXP0.$assign                      = "ball.AR21";
iCPSW9X1.SGMII7_TXN0.$assign                      = "ball.AR20";
iCPSW9X1.SGMII7_RXP0.$assign                      = "ball.AU21";
iCPSW9X1.SGMII7_RXN0.$assign                      = "ball.AU20";
iCPSW9X1.SGMII8_TXP0.$assign                      = "ball.AP20";
iCPSW9X1.SGMII8_TXN0.$assign                      = "ball.AP19";
iCPSW9X1.SGMII8_RXP0.$assign                      = "ball.AT20";
iCPSW9X1.SGMII8_RXN0.$assign                      = "ball.AT19";
const iCSI1                                       = scripting.addPeripheral("CSI");
iCSI1.$name                                       = "MyCSI0";
iCSI1.RXCLKN.$assign                              = "ball.AN30";
iCSI1.RXCLKP.$assign                              = "ball.AN29";
iCSI1.RXN0.$assign                                = "ball.AU33";
iCSI1.RXN1.$assign                                = "ball.AT32";
iCSI1.RXN2.$assign                                = "ball.AV31";
iCSI1.RXN3.$assign                                = "ball.AR30";
iCSI1.RXP0.$assign                                = "ball.AU32";
iCSI1.RXP1.$assign                                = "ball.AT31";
iCSI1.RXP2.$assign                                = "ball.AV30";
iCSI1.RXP3.$assign                                = "ball.AR29";
iCSI1.RXRCALIB.$assign                            = "ball.AM28";
iCSI1.TXCLKN.$used                                = false;
iCSI1.TXCLKP.$used                                = false;
iCSI1.TXN0.$used                                  = false;
iCSI1.TXN1.$used                                  = false;
iCSI1.TXN2.$used                                  = false;
iCSI1.TXN3.$used                                  = false;
iCSI1.TXP0.$used                                  = false;
iCSI1.TXP1.$used                                  = false;
iCSI1.TXP2.$used                                  = false;
iCSI1.TXP3.$used                                  = false;
const iCSI2                                       = scripting.addPeripheral("CSI");
iCSI2.$name                                       = "MyCSI1";
iCSI2.RXCLKN.$assign                              = "ball.AP32";
iCSI2.RXCLKP.$assign                              = "ball.AP31";
iCSI2.RXN0.$assign                                = "ball.AT35";
iCSI2.RXN1.$assign                                = "ball.AU36";
iCSI2.RXN2.$assign                                = "ball.AR33";
iCSI2.RXN3.$assign                                = "ball.AV34";
iCSI2.RXP0.$assign                                = "ball.AT34";
iCSI2.RXP1.$assign                                = "ball.AU35";
iCSI2.RXP2.$assign                                = "ball.AR32";
iCSI2.RXP3.$assign                                = "ball.AV33";
iCSI2.RXRCALIB.$assign                            = "ball.AL28";
iCSI2.TXCLKN.$used                                = false;
iCSI2.TXCLKP.$used                                = false;
iCSI2.TXN0.$used                                  = false;
iCSI2.TXN1.$used                                  = false;
iCSI2.TXN2.$used                                  = false;
iCSI2.TXN3.$used                                  = false;
iCSI2.TXP0.$used                                  = false;
iCSI2.TXP1.$used                                  = false;
iCSI2.TXP2.$used                                  = false;
iCSI2.TXP3.$used                                  = false;
const iCSI3                                       = scripting.addPeripheral("CSI");
iCSI3.$name                                       = "MyCSI2";
iCSI3.RXCLKN.$assign                              = "ball.AN32";
iCSI3.RXCLKP.$assign                              = "ball.AN33";
iCSI3.RXN0.$assign                                = "ball.AR36";
iCSI3.RXN1.$assign                                = "ball.AT38";
iCSI3.RXN2.$assign                                = "ball.AP35";
iCSI3.RXN3.$assign                                = "ball.AV37";
iCSI3.RXP0.$assign                                = "ball.AR35";
iCSI3.RXP1.$assign                                = "ball.AT37";
iCSI3.RXP2.$assign                                = "ball.AP34";
iCSI3.RXP3.$assign                                = "ball.AV36";
iCSI3.RXRCALIB.$assign                            = "ball.AM31";
iCSI3.TXCLKN.$used                                = false;
iCSI3.TXCLKP.$used                                = false;
iCSI3.TXN0.$used                                  = false;
iCSI3.TXN1.$used                                  = false;
iCSI3.TXN2.$used                                  = false;
iCSI3.TXN3.$used                                  = false;
iCSI3.TXP0.$used                                  = false;
iCSI3.TXP1.$used                                  = false;
iCSI3.TXP2.$used                                  = false;
iCSI3.TXP3.$used                                  = false;
const iDDRSS1                                     = scripting.addPeripheral("DDRSS");
iDDRSS1.$name                                     = "MyDDRSS0";
iDDRSS1.CA0.$assign                               = "ball.AD2";
iDDRSS1.CA1.$assign                               = "ball.AC5";
iDDRSS1.CA2.$assign                               = "ball.AB4";
iDDRSS1.CA3.$assign                               = "ball.AC4";
iDDRSS1.CA4.$assign                               = "ball.AB3";
iDDRSS1.CA5.$assign                               = "ball.AC3";
iDDRSS1.CAL0.$assign                              = "ball.AE8";
iDDRSS1.CKE0.$assign                              = "ball.AB6";
iDDRSS1.CKE1.$assign                              = "ball.AD3";
iDDRSS1.CKN.$assign                               = "ball.AB2";
iDDRSS1.CKP.$assign                               = "ball.AC1";
iDDRSS1.CSn0_0.$assign                            = "ball.AD7";
iDDRSS1.CSn0_1.$assign                            = "ball.AC7";
iDDRSS1.CSn1_0.$assign                            = "ball.AB7";
iDDRSS1.CSn1_1.$assign                            = "ball.AD6";
iDDRSS1.DM0.$assign                               = "ball.V3";
iDDRSS1.DM1.$assign                               = "ball.AA4";
iDDRSS1.DM2.$assign                               = "ball.AG2";
iDDRSS1.DM3.$assign                               = "ball.AJ5";
iDDRSS1.DQ0.$assign                               = "ball.U2";
iDDRSS1.DQ1.$assign                               = "ball.U4";
iDDRSS1.DQ10.$assign                              = "ball.AA3";
iDDRSS1.DQ11.$assign                              = "ball.W2";
iDDRSS1.DQ12.$assign                              = "ball.AA6";
iDDRSS1.DQ13.$assign                              = "ball.Y4";
iDDRSS1.DQ14.$assign                              = "ball.Y5";
iDDRSS1.DQ15.$assign                              = "ball.AA7";
iDDRSS1.DQ16.$assign                              = "ball.AF2";
iDDRSS1.DQ17.$assign                              = "ball.AE7";
iDDRSS1.DQ18.$assign                              = "ball.AG3";
iDDRSS1.DQ19.$assign                              = "ball.AF5";
iDDRSS1.DQ2.$assign                               = "ball.W6";
iDDRSS1.DQ20.$assign                              = "ball.AE6";
iDDRSS1.DQ22.$assign                              = "ball.AE3";
iDDRSS1.DQ23.$assign                              = "ball.AE4";
iDDRSS1.DQ24.$assign                              = "ball.AG5";
iDDRSS1.DQ25.$assign                              = "ball.AH3";
iDDRSS1.DQ26.$assign                              = "ball.AJ2";
iDDRSS1.DQ27.$assign                              = "ball.AH4";
iDDRSS1.DQ28.$assign                              = "ball.AJ4";
iDDRSS1.DQ29.$assign                              = "ball.AH6";
iDDRSS1.DQ3.$assign                               = "ball.W5";
iDDRSS1.DQ30.$assign                              = "ball.AH7";
iDDRSS1.DQ31.$assign                              = "ball.AG6";
iDDRSS1.DQ4.$assign                               = "ball.V4";
iDDRSS1.DQ5.$assign                               = "ball.V7";
iDDRSS1.DQ6.$assign                               = "ball.U5";
iDDRSS1.DQ7.$assign                               = "ball.V6";
iDDRSS1.DQ8.$assign                               = "ball.Y2";
iDDRSS1.DQ9.$assign                               = "ball.W3";
iDDRSS1.DQS0N.$assign                             = "ball.V1";
iDDRSS1.DQS0P.$assign                             = "ball.U1";
iDDRSS1.DQS1N.$assign                             = "ball.Y1";
iDDRSS1.DQS1P.$assign                             = "ball.AA1";
iDDRSS1.DQS2N.$assign                             = "ball.AE1";
iDDRSS1.DQS2P.$assign                             = "ball.AF1";
iDDRSS1.DQS3N.$assign                             = "ball.AH1";
iDDRSS1.DQS3P.$assign                             = "ball.AJ1";
iDDRSS1.RESETn.$assign                            = "ball.AD5";
iDDRSS1.RET.$assign                               = "ball.AC8";
const iDDRSS2                                     = scripting.addPeripheral("DDRSS");
iDDRSS2.$name                                     = "MyDDRSS1";
iDDRSS2.CA0.$assign                               = "ball.F12";
iDDRSS2.CA1.$assign                               = "ball.C12";
iDDRSS2.CA2.$assign                               = "ball.B12";
iDDRSS2.CA3.$assign                               = "ball.C11";
iDDRSS2.CA4.$assign                               = "ball.D12";
iDDRSS2.CA5.$assign                               = "ball.E10";
iDDRSS2.CAL0.$assign                              = "ball.G14";
iDDRSS2.CKE0.$assign                              = "ball.D11";
iDDRSS2.CKE1.$assign                              = "ball.C10";
iDDRSS2.CKN.$assign                               = "ball.A11";
iDDRSS2.CKP.$assign                               = "ball.B10";
iDDRSS2.CSn0_0.$assign                            = "ball.E11";
iDDRSS2.CSn0_1.$assign                            = "ball.G11";
iDDRSS2.CSn1_0.$assign                            = "ball.F10";
iDDRSS2.CSn1_1.$assign                            = "ball.G12";
iDDRSS2.DM0.$assign                               = "ball.E17";
iDDRSS2.DM1.$assign                               = "ball.C15";
iDDRSS2.DM2.$assign                               = "ball.D8";
iDDRSS2.DM3.$assign                               = "ball.C1";
iDDRSS2.DQ0.$assign                               = "ball.F16";
iDDRSS2.DQ1.$assign                               = "ball.G16";
iDDRSS2.DQ10.$assign                              = "ball.C13";
iDDRSS2.DQ11.$assign                              = "ball.D13";
iDDRSS2.DQ12.$assign                              = "ball.F13";
iDDRSS2.DQ13.$assign                              = "ball.G13";
iDDRSS2.DQ14.$assign                              = "ball.E14";
iDDRSS2.DQ15.$assign                              = "ball.D14";
iDDRSS2.DQ16.$assign                              = "ball.E8";
iDDRSS2.DQ17.$assign                              = "ball.G9";
iDDRSS2.DQ18.$assign                              = "ball.F9";
iDDRSS2.DQ19.$assign                              = "ball.D9";
iDDRSS2.DQ2.$assign                               = "ball.F15";
iDDRSS2.DQ20.$assign                              = "ball.C9";
iDDRSS2.DQ21.$assign                              = "ball.B8";
iDDRSS2.DQ22.$assign                              = "ball.B7";
iDDRSS2.DQ23.$assign                              = "ball.C7";
iDDRSS2.DQ24.$assign                              = "ball.B2";
iDDRSS2.DQ25.$assign                              = "ball.B3";
iDDRSS2.DQ26.$assign                              = "ball.B4";
iDDRSS2.DQ27.$assign                              = "ball.B5";
iDDRSS2.DQ28.$assign                              = "ball.A6";
iDDRSS2.DQ29.$assign                              = "ball.C5";
iDDRSS2.DQ3.$assign                               = "ball.E15";
iDDRSS2.DQ30.$assign                              = "ball.C6";
iDDRSS2.DQ31.$assign                              = "ball.C3";
iDDRSS2.DQ4.$assign                               = "ball.D16";
iDDRSS2.DQ5.$assign                               = "ball.C16";
iDDRSS2.DQ6.$assign                               = "ball.B17";
iDDRSS2.DQ7.$assign                               = "ball.D17";
iDDRSS2.DQ8.$assign                               = "ball.B15";
iDDRSS2.DQ9.$assign                               = "ball.B14";
iDDRSS2.DQS0N.$assign                             = "ball.A17";
iDDRSS2.DQS0P.$assign                             = "ball.A16";
iDDRSS2.DQS1N.$assign                             = "ball.A14";
iDDRSS2.DQS1P.$assign                             = "ball.A13";
iDDRSS2.DQS2N.$assign                             = "ball.A9";
iDDRSS2.DQS2P.$assign                             = "ball.A8";
iDDRSS2.DQS3N.$assign                             = "ball.A4";
iDDRSS2.DQS3P.$assign                             = "ball.A3";
iDDRSS2.RESETn.$assign                            = "ball.G10";
iDDRSS2.RET.$assign                               = "ball.G8";
const iDDRSS3                                     = scripting.addPeripheral("DDRSS");
iDDRSS3.$name                                     = "MyDDRSS2";
iDDRSS3.CA0.$assign                               = "ball.K3";
iDDRSS3.CA1.$assign                               = "ball.L3";
iDDRSS3.CA2.$assign                               = "ball.K5";
iDDRSS3.CA3.$assign                               = "ball.L4";
iDDRSS3.CA4.$assign                               = "ball.K4";
iDDRSS3.CA5.$assign                               = "ball.L7";
iDDRSS3.CAL0.$assign                              = "ball.U7";
iDDRSS3.CKE0.$assign                              = "ball.L6";
iDDRSS3.CKE1.$assign                              = "ball.J2";
iDDRSS3.CKN.$assign                               = "ball.K1";
iDDRSS3.CKP.$assign                               = "ball.L2";
iDDRSS3.CSn0_0.$assign                            = "ball.J3";
iDDRSS3.CSn0_1.$assign                            = "ball.J6";
iDDRSS3.CSn1_0.$assign                            = "ball.J7";
iDDRSS3.CSn1_1.$assign                            = "ball.K7";
iDDRSS3.DM0.$assign                               = "ball.T2";
iDDRSS3.DM1.$assign                               = "ball.M6";
iDDRSS3.DM2.$assign                               = "ball.G4";
iDDRSS3.DM3.$assign                               = "ball.D5";
iDDRSS3.DQ0.$assign                               = "ball.T4";
iDDRSS3.DQ1.$assign                               = "ball.R6";
iDDRSS3.DQ10.$assign                              = "ball.P2";
iDDRSS3.DQ11.$assign                              = "ball.P3";
iDDRSS3.DQ12.$assign                              = "ball.M7";
iDDRSS3.DQ13.$assign                              = "ball.N5";
iDDRSS3.DQ14.$assign                              = "ball.M4";
iDDRSS3.DQ15.$assign                              = "ball.M3";
iDDRSS3.DQ16.$assign                              = "ball.F3";
iDDRSS3.DQ17.$assign                              = "ball.G7";
iDDRSS3.DQ18.$assign                              = "ball.H6";
iDDRSS3.DQ19.$assign                              = "ball.H4";
iDDRSS3.DQ2.$assign                               = "ball.R3";
iDDRSS3.DQ20.$assign                              = "ball.G2";
iDDRSS3.DQ21.$assign                              = "ball.H3";
iDDRSS3.DQ22.$assign                              = "ball.G5";
iDDRSS3.DQ23.$assign                              = "ball.F2";
iDDRSS3.DQ24.$assign                              = "ball.E4";
iDDRSS3.DQ25.$assign                              = "ball.D2";
iDDRSS3.DQ26.$assign                              = "ball.F6";
iDDRSS3.DQ27.$assign                              = "ball.F5";
iDDRSS3.DQ28.$assign                              = "ball.E3";
iDDRSS3.DQ29.$assign                              = "ball.E7";
iDDRSS3.DQ3.$assign                               = "ball.R4";
iDDRSS3.DQ30.$assign                              = "ball.E6";
iDDRSS3.DQ31.$assign                              = "ball.D4";
iDDRSS3.DQ4.$assign                               = "ball.P6";
iDDRSS3.DQ5.$assign                               = "ball.P5";
iDDRSS3.DQ6.$assign                               = "ball.T5";
iDDRSS3.DQ7.$assign                               = "ball.R7";
iDDRSS3.DQ8.$assign                               = "ball.N2";
iDDRSS3.DQ9.$assign                               = "ball.N4";
iDDRSS3.DQS0N.$assign                             = "ball.R1";
iDDRSS3.DQS0P.$assign                             = "ball.T1";
iDDRSS3.DQS1N.$assign                             = "ball.M1";
iDDRSS3.DQS1P.$assign                             = "ball.N1";
iDDRSS3.DQS2N.$assign                             = "ball.G1";
iDDRSS3.DQS2P.$assign                             = "ball.H1";
iDDRSS3.DQS3N.$assign                             = "ball.D1";
iDDRSS3.DQS3P.$assign                             = "ball.E1";
iDDRSS3.RESETn.$assign                            = "ball.J5";
iDDRSS3.RET.$assign                               = "ball.L8";
const iDDRSS4                                     = scripting.addPeripheral("DDRSS");
iDDRSS4.$name                                     = "MyDDRSS3";
iDDRSS4.CA0.$assign                               = "ball.D25";
iDDRSS4.CA1.$assign                               = "ball.B23";
iDDRSS4.CA2.$assign                               = "ball.D24";
iDDRSS4.CA3.$assign                               = "ball.C24";
iDDRSS4.CA4.$assign                               = "ball.E23";
iDDRSS4.CA5.$assign                               = "ball.F23";
iDDRSS4.CAL0.$assign                              = "ball.F18";
iDDRSS4.CKE0.$assign                              = "ball.C25";
iDDRSS4.CKE1.$assign                              = "ball.G24";
iDDRSS4.CKN.$assign                               = "ball.B25";
iDDRSS4.CKP.$assign                               = "ball.A24";
iDDRSS4.CSn0_0.$assign                            = "ball.G23";
iDDRSS4.CSn0_1.$assign                            = "ball.G25";
iDDRSS4.CSn1_0.$assign                            = "ball.F25";
iDDRSS4.CSn1_1.$assign                            = "ball.E24";
iDDRSS4.DM0.$assign                               = "ball.E18";
iDDRSS4.DM1.$assign                               = "ball.D21";
iDDRSS4.DM2.$assign                               = "ball.C28";
iDDRSS4.DM3.$assign                               = "ball.E30";
iDDRSS4.DQ0.$assign                               = "ball.D18";
iDDRSS4.DQ1.$assign                               = "ball.B18";
iDDRSS4.DQ10.$assign                              = "ball.F22";
iDDRSS4.DQ11.$assign                              = "ball.D22";
iDDRSS4.DQ12.$assign                              = "ball.C22";
iDDRSS4.DQ13.$assign                              = "ball.B21";
iDDRSS4.DQ14.$assign                              = "ball.B20";
iDDRSS4.DQ15.$assign                              = "ball.C20";
iDDRSS4.DQ16.$assign                              = "ball.B28";
iDDRSS4.DQ17.$assign                              = "ball.B27";
iDDRSS4.DQ18.$assign                              = "ball.C26";
iDDRSS4.DQ19.$assign                              = "ball.D26";
iDDRSS4.DQ2.$assign                               = "ball.C19";
iDDRSS4.DQ20.$assign                              = "ball.F26";
iDDRSS4.DQ21.$assign                              = "ball.G26";
iDDRSS4.DQ22.$assign                              = "ball.E27";
iDDRSS4.DQ23.$assign                              = "ball.D27";
iDDRSS4.DQ24.$assign                              = "ball.F29";
iDDRSS4.DQ25.$assign                              = "ball.G29";
iDDRSS4.DQ26.$assign                              = "ball.F28";
iDDRSS4.DQ27.$assign                              = "ball.E28";
iDDRSS4.DQ28.$assign                              = "ball.D29";
iDDRSS4.DQ29.$assign                              = "ball.C29";
iDDRSS4.DQ3.$assign                               = "ball.D19";
iDDRSS4.DQ30.$assign                              = "ball.B30";
iDDRSS4.DQ31.$assign                              = "ball.D30";
iDDRSS4.DQ4.$assign                               = "ball.F20";
iDDRSS4.DQ5.$assign                               = "ball.E20";
iDDRSS4.DQ6.$assign                               = "ball.G19";
iDDRSS4.DQ7.$assign                               = "ball.F19";
iDDRSS4.DQ8.$assign                               = "ball.E21";
iDDRSS4.DQ9.$assign                               = "ball.G21";
iDDRSS4.DQS0N.$assign                             = "ball.A19";
iDDRSS4.DQS0P.$assign                             = "ball.A18";
iDDRSS4.DQS1N.$assign                             = "ball.A22";
iDDRSS4.DQS1P.$assign                             = "ball.A21";
iDDRSS4.DQS2N.$assign                             = "ball.A27";
iDDRSS4.DQS2P.$assign                             = "ball.A26";
iDDRSS4.DQS3N.$assign                             = "ball.A30";
iDDRSS4.DQS3P.$assign                             = "ball.A29";
iDDRSS4.RESETn.$assign                            = "ball.C23";
iDDRSS4.RET.$assign                               = "ball.G27";
const iDP1                                        = scripting.addPeripheral("DP");
iDP1.$name                                        = "MyDP";
iDP1.HPD.$assign                                  = "ball.AM37";
iDP1.TXN0.$assign                                 = "ball.AP13";
iDP1.TXN1.$assign                                 = "ball.AT13";
iDP1.TXN2.$assign                                 = "ball.AT16";
iDP1.TXN3.$assign                                 = "ball.AV18";
iDP1.TXP0.$assign                                 = "ball.AP14";
iDP1.TXP1.$assign                                 = "ball.AT14";
iDP1.TXP2.$assign                                 = "ball.AT17";
iDP1.TXP3.$assign                                 = "ball.AV19";
const iDSI1                                       = scripting.addPeripheral("DSI");
iDSI1.$name                                       = "MyDSI";
iDSI1.TXCLKN.$assign                              = "ball.AP26";
iDSI1.TXCLKP.$assign                              = "ball.AP25";
iDSI1.TXN0.$assign                                = "ball.AU27";
iDSI1.TXN1.$assign                                = "ball.AT26";
iDSI1.TXN2.$assign                                = "ball.AR27";
iDSI1.TXN3.$assign                                = "ball.AN24";
iDSI1.TXP0.$assign                                = "ball.AU26";
iDSI1.TXP1.$assign                                = "ball.AT25";
iDSI1.TXP2.$assign                                = "ball.AR26";
iDSI1.TXP3.$assign                                = "ball.AN23";
iDSI1.TXRCALIB.$assign                            = "ball.AM24";
const iGPIO_VDDSHV21                              = scripting.addPeripheral("GPIO_VDDSHV2");
iGPIO_VDDSHV21["1"].$used                         = false;
iGPIO_VDDSHV21["2"].$used                         = false;
iGPIO_VDDSHV21["3"].$assign                       = "ball.AF33";
iGPIO_VDDSHV21["4"].$used                         = false;
iGPIO_VDDSHV21["5"].$used                         = false;
iGPIO_VDDSHV21["6"].$used                         = false;
iGPIO_VDDSHV21["7"].$used                         = false;
iGPIO_VDDSHV21["8"].$assign                       = "ball.AJ35";
iGPIO_VDDSHV21["9"].$used                         = false;
iGPIO_VDDSHV21["10"].$used                        = false;
iGPIO_VDDSHV21["11"].$assign                      = "ball.AL32";
iGPIO_VDDSHV21["12"].$used                        = false;
iGPIO_VDDSHV21["13"].$used                        = false;
iGPIO_VDDSHV21["14"].$used                        = false;
iGPIO_VDDSHV21["15"].$used                        = false;
iGPIO_VDDSHV21["16"].$used                        = false;
iGPIO_VDDSHV21["17"].$used                        = false;
iGPIO_VDDSHV21["18"].$assign                      = "ball.AK33";
iGPIO_VDDSHV21["19"].$used                        = false;
iGPIO_VDDSHV21["20"].$used                        = false;
iGPIO_VDDSHV21["21"].$assign                      = "ball.AD37";
iGPIO_VDDSHV21["22"].$used                        = false;
iGPIO_VDDSHV21["23"].$used                        = false;
iGPIO_VDDSHV21["24"].$used                        = false;
iGPIO_VDDSHV21["25"].$used                        = false;
iGPIO_VDDSHV21["26"].$assign                      = "ball.AE38";
iGPIO_VDDSHV21["27"].$used                        = false;
iGPIO_VDDSHV21["28"].$assign                      = "ball.AH38";
iGPIO_VDDSHV21["29"].$used                        = false;
iGPIO_VDDSHV21["30"].$used                        = false;
iGPIO_VDDSHV21["31"].$used                        = false;
iGPIO_VDDSHV21["32"].$used                        = false;
iGPIO_VDDSHV21["33"].$used                        = false;
iGPIO_VDDSHV21["34"].$used                        = false;
iGPIO_VDDSHV21["35"].$used                        = false;
iGPIO_VDDSHV21["36"].$used                        = false;
iGPIO_VDDSHV21["37"].$used                        = false;
iGPIO_VDDSHV21["38"].$used                        = false;
iGPIO_VDDSHV21["39"].$used                        = false;
iGPIO_VDDSHV21["40"].$used                        = false;
iGPIO_VDDSHV21["41"].$used                        = false;
iGPIO_VDDSHV21["42"].$used                        = false;
iGPIO_VDDSHV21["43"].$used                        = false;
iGPIO_VDDSHV21["44"].$used                        = false;
iGPIO_VDDSHV21["45"].$used                        = false;
iGPIO_VDDSHV21["46"].$used                        = false;
iGPIO_VDDSHV21["47"].$used                        = false;
iGPIO_VDDSHV21["48"].$used                        = false;
iGPIO_VDDSHV21["49"].$used                        = false;
iGPIO_VDDSHV21["50"].$used                        = false;
iGPIO_VDDSHV21.$name                              = "MyGPIO_VDDSHV2";
const iI2C1                                       = scripting.addPeripheral("I2C");
iI2C1.$name                                       = "MyI2C4";
iI2C1.$assign                                     = "I2C_4";
iI2C1.SCL.$assign                                 = "ball.AG33";
iI2C1.SDA.$assign                                 = "ball.AH33";
const iI2C2                                       = scripting.addPeripheral("I2C");
iI2C2.$name                                       = "MyI2C5";
iI2C2.$assign                                     = "I2C_5";
iI2C2.SCL.$assign                                 = "ball.AG34";
iI2C2.SDA.$assign                                 = "ball.AK36";
const iI2C3                                       = scripting.addPeripheral("I2C");
iI2C3.$name                                       = "MyI2C3";
iI2C3.$assign                                     = "I2C_3";
iI2C3.SCL.$assign                                 = "ball.AF38";
iI2C3.SDA.$assign                                 = "ball.AE36";
const iI2C4                                       = scripting.addPeripheral("I2C");
iI2C4.$name                                       = "MyI2C1";
iI2C4.$assign                                     = "I2C_1";
iI2C4.SCL.$assign                                 = "ball.AD36";
iI2C4.SDA.$assign                                 = "ball.AJ32";
const iI2C5                                       = scripting.addPeripheral("I2C");
iI2C5.$name                                       = "MyI2C0";
iI2C5.SCL.$assign                                 = "ball.AN36";
iI2C5.SDA.$assign                                 = "ball.AP37";
const iJTAG_VDDSHV01                              = scripting.addPeripheral("JTAG_VDDSHV0");
iJTAG_VDDSHV01.$name                              = "MyJTAG_VDDSHV0";
iJTAG_VDDSHV01.TDI.$assign                        = "ball.AL37";
iJTAG_VDDSHV01.TDO.$assign                        = "ball.AL35";
iJTAG_VDDSHV01.TMS.$assign                        = "ball.AL36";
const iMCAN1                                      = scripting.addPeripheral("MCAN");
iMCAN1.$name                                      = "MyMCAN16";
iMCAN1.$assign                                    = "MCAN_16";
iMCAN1.RX.$assign                                 = "ball.AE33";
iMCAN1.TX.$assign                                 = "ball.AH34";
const iMCAN2                                      = scripting.addPeripheral("MCAN");
iMCAN2.$name                                      = "MyMCAN5";
iMCAN2.$assign                                    = "MCAN_5";
iMCAN2.RX.$assign                                 = "ball.AK38";
iMCAN2.TX.$assign                                 = "ball.AK35";
const iMCAN3                                      = scripting.addPeripheral("MCAN");
iMCAN3.$name                                      = "MyMCAN3";
iMCAN3.$assign                                    = "MCAN_3";
iMCAN3.RX.$assign                                 = "ball.AK34";
iMCAN3.TX.$assign                                 = "ball.AJ38";
const iMCAN4                                      = scripting.addPeripheral("MCAN");
iMCAN4.$name                                      = "MyMCAN4";
iMCAN4.$assign                                    = "MCAN_4";
iMCAN4.RX.$assign                                 = "ball.AF36";
iMCAN4.TX.$assign                                 = "ball.AG38";
const iMCU_ADC1                                   = scripting.addPeripheral("MCU_ADC");
iMCU_ADC1.$name                                   = "MyMCU_ADC0";
iMCU_ADC1.REFP.$assign                            = "ball.R35";
iMCU_ADC1.REFN.$assign                            = "ball.U35";
iMCU_ADC1.AIN0.$assign                            = "ball.P36";
iMCU_ADC1.AIN1.$assign                            = "ball.V36";
iMCU_ADC1.AIN2.$assign                            = "ball.T34";
iMCU_ADC1.AIN3.$assign                            = "ball.T36";
iMCU_ADC1.AIN4.$assign                            = "ball.P34";
iMCU_ADC1.AIN5.$assign                            = "ball.R37";
iMCU_ADC1.AIN6.$assign                            = "ball.R33";
iMCU_ADC1.AIN7.$assign                            = "ball.V38";
const iMCU_CPSW2G1                                = scripting.addPeripheral("MCU_CPSW2G");
iMCU_CPSW2G1.$name                                = "MyMCU_CPSW2G";
iMCU_CPSW2G1.RGMII1_RD0.$assign                   = "ball.A35";
iMCU_CPSW2G1.RGMII1_RD1.$assign                   = "ball.B36";
iMCU_CPSW2G1.RGMII1_RD2.$assign                   = "ball.C36";
iMCU_CPSW2G1.RGMII1_RD3.$assign                   = "ball.D36";
iMCU_CPSW2G1.RGMII1_RXC.$assign                   = "ball.B37";
iMCU_CPSW2G1.RGMII1_RX_CTL.$assign                = "ball.C37";
iMCU_CPSW2G1.RGMII1_TD0.$assign                   = "ball.D37";
iMCU_CPSW2G1.RGMII1_TD1.$assign                   = "ball.D38";
iMCU_CPSW2G1.RGMII1_TD2.$assign                   = "ball.E37";
iMCU_CPSW2G1.RGMII1_TD3.$assign                   = "ball.E38";
iMCU_CPSW2G1.RGMII1_TXC.$assign                   = "ball.E36";
iMCU_CPSW2G1.RGMII1_TX_CTL.$assign                = "ball.C38";
scripting.suppress("Solution may have changed,No suggested solution was provided, so this value may differ from the last time this tool was run", iMCU_CPSW2G1, "RGMII1_RXC");
const iMCU_I2C1                                   = scripting.addPeripheral("MCU_I2C");
iMCU_I2C1.$name                                   = "MyMCU_I2C0";
iMCU_I2C1.$assign                                 = "MCU_I2C_0";
iMCU_I2C1.SCL.$assign                             = "ball.M35";
iMCU_I2C1.SDA.$assign                             = "ball.G34";
const iMCU_I3C1                                   = scripting.addPeripheral("MCU_I3C");
iMCU_I3C1.$name                                   = "MyMCU_I3C";
iMCU_I3C1.$assign                                 = "MCU_I3C_0";
iMCU_I3C1.SCL.$assign                             = "ball.L35";
iMCU_I3C1.SDA.$assign                             = "ball.L34";
iMCU_I3C1.SDAPULLEN.$assign                       = "ball.M38";
const iMCU_MCAN1                                  = scripting.addPeripheral("MCU_MCAN");
iMCU_MCAN1.$name                                  = "MyMCU_MCAN0";
iMCU_MCAN1.$assign                                = "MCU_MCAN_0";
iMCU_MCAN1.RX.$assign                             = "ball.F38";
iMCU_MCAN1.TX.$assign                             = "ball.K33";
const iMCU_MCAN2                                  = scripting.addPeripheral("MCU_MCAN");
iMCU_MCAN2.$name                                  = "MyMCU_MCAN1";
iMCU_MCAN2.$assign                                = "MCU_MCAN_1";
iMCU_MCAN2.RX.$assign                             = "ball.K36";
iMCU_MCAN2.TX.$assign                             = "ball.H35";
const iMCU_MDIO1                                  = scripting.addPeripheral("MCU_MDIO");
iMCU_MDIO1.$name                                  = "MyMCU_MDIO";
iMCU_MDIO1.MDC.$assign                            = "ball.A36";
iMCU_MDIO1.MDIO.$assign                           = "ball.B35";
const iMCU_OSPI1                                  = scripting.addPeripheral("MCU_OSPI");
iMCU_OSPI1.$name                                  = "MyMCU_OSPI0";
iMCU_OSPI1.CLK.$assign                            = "ball.E32";
iMCU_OSPI1.CSn0.$assign                           = "ball.A32";
iMCU_OSPI1.CSn1.$used                             = false;
iMCU_OSPI1.CSn2.$used                             = false;
iMCU_OSPI1.CSn3.$used                             = false;
iMCU_OSPI1.D0.$assign                             = "ball.B33";
iMCU_OSPI1.D1.$assign                             = "ball.B32";
iMCU_OSPI1.D2.$assign                             = "ball.C33";
iMCU_OSPI1.D3.$assign                             = "ball.C35";
iMCU_OSPI1.D4.$assign                             = "ball.D33";
iMCU_OSPI1.D5.$assign                             = "ball.D34";
iMCU_OSPI1.D6.$assign                             = "ball.E34";
iMCU_OSPI1.D7.$assign                             = "ball.E33";
iMCU_OSPI1.DQS.$assign                            = "ball.C34";
iMCU_OSPI1.ECC_FAIL.$assign                       = "ball.C32";
iMCU_OSPI1.LBCLKO.$used                           = false;
iMCU_OSPI1.RESET_OUT0.$assign                     = "ball.B34";
iMCU_OSPI1.RESET_OUT1.$used                       = false;
const iMCU_OSPI2                                  = scripting.addPeripheral("MCU_OSPI");
iMCU_OSPI2.$name                                  = "MyMCU_OSPI1";
iMCU_OSPI2.$assign                                = "MCU_OSPI_1";
iMCU_OSPI2.CLK.$assign                            = "ball.F32";
iMCU_OSPI2.CSn0.$assign                           = "ball.G32";
iMCU_OSPI2.CSn1.$used                             = false;
iMCU_OSPI2.CSn2.$used                             = false;
iMCU_OSPI2.CSn3.$used                             = false;
iMCU_OSPI2.D0.$assign                             = "ball.E35";
iMCU_OSPI2.D1.$assign                             = "ball.D31";
iMCU_OSPI2.D2.$assign                             = "ball.G31";
iMCU_OSPI2.D3.$assign                             = "ball.F33";
iMCU_OSPI2.D4.$used                               = false;
iMCU_OSPI2.D5.$used                               = false;
iMCU_OSPI2.D6.$used                               = false;
iMCU_OSPI2.D7.$used                               = false;
iMCU_OSPI2.DQS.$assign                            = "ball.F31";
iMCU_OSPI2.ECC_FAIL.$used                         = false;
iMCU_OSPI2.LBCLKO.$assign                         = "ball.C31";
iMCU_OSPI2.RESET_OUT0.$used                       = false;
iMCU_OSPI2.RESET_OUT1.$used                       = false;
const iMCU_UART1                                  = scripting.addPeripheral("MCU_UART");
iMCU_UART1.$name                                  = "MyMCU_UART0";
iMCU_UART1.$assign                                = "MCU_USART_0";
iMCU_UART1.CTSn.$assign                           = "ball.H37";
iMCU_UART1.RTSn.$assign                           = "ball.K37";
iMCU_UART1.RXD.$assign                            = "ball.K38";
iMCU_UART1.TXD.$assign                            = "ball.J37";
const iMMCSD1                                     = scripting.addPeripheral("MMCSD");
iMMCSD1.$name                                     = "MyMMCSD0";
iMMCSD1.$assign                                   = "MMC_0";
iMMCSD1.CALPAD.$assign                            = "ball.AJ7";
iMMCSD1.CLK.$assign                               = "ball.AK5";
iMMCSD1.CMD.$assign                               = "ball.AL8";
iMMCSD1.DAT0.$assign                              = "ball.AK9";
iMMCSD1.DAT1.$assign                              = "ball.AL6";
iMMCSD1.DAT2.$assign                              = "ball.AK8";
iMMCSD1.DAT3.$assign                              = "ball.AK6";
iMMCSD1.DAT4.$assign                              = "ball.AK7";
iMMCSD1.DAT5.$assign                              = "ball.AL7";
iMMCSD1.DAT6.$assign                              = "ball.AL5";
iMMCSD1.DAT7.$assign                              = "ball.AK3";
iMMCSD1.DS.$assign                                = "ball.AK4";
iMMCSD1.SDCD.$used                                = false;
iMMCSD1.SDWP.$used                                = false;
const iMMCSD2                                     = scripting.addPeripheral("MMCSD");
iMMCSD2.$name                                     = "MyMMCSD1";
iMMCSD2.$assign                                   = "MMC_1";
iMMCSD2.CALPAD.$used                              = false;
iMMCSD2.CLK.$assign                               = "ball.AB38";
iMMCSD2.CMD.$assign                               = "ball.AB36";
iMMCSD2.DAT0.$assign                              = "ball.AA33";
iMMCSD2.DAT1.$assign                              = "ball.AB34";
iMMCSD2.DAT2.$assign                              = "ball.AA32";
iMMCSD2.DAT3.$assign                              = "ball.AC38";
iMMCSD2.DAT4.$used                                = false;
iMMCSD2.DAT5.$used                                = false;
iMMCSD2.DAT6.$used                                = false;
iMMCSD2.DAT7.$used                                = false;
iMMCSD2.DS.$used                                  = false;
iMMCSD2.SDCD.$assign                              = "ball.AR38";
iMMCSD2.SDWP.$used                                = false;
const iOSC1                                       = scripting.addPeripheral("OSC");
iOSC1.$name                                       = "MyOSC1";
iOSC1.$assign                                     = "OSC_1";
iOSC1.XI.$assign                                  = "ball.P38";
iOSC1.XO.$assign                                  = "ball.N37";
const iPCIE1                                      = scripting.addPeripheral("PCIE");
iPCIE1.$name                                      = "MyPCIE1";
iPCIE1.$assign                                    = "PCIE_1";
iPCIE1.REFCLK_N_OUT.$assign                       = "ball.AN8";
iPCIE1.CLKREQn.$used                              = false;
iPCIE1.RXN0.$assign                               = "ball.AR8";
iPCIE1.RXN1.$assign                               = "ball.AT10";
iPCIE1.RXN2.$used                                 = false;
iPCIE1.RXN3.$used                                 = false;
iPCIE1.RXP0.$assign                               = "ball.AR9";
iPCIE1.RXP1.$assign                               = "ball.AT11";
iPCIE1.RXP2.$used                                 = false;
iPCIE1.RXP3.$used                                 = false;
iPCIE1.TXN0.$assign                               = "ball.AT7";
iPCIE1.TXN1.$assign                               = "ball.AP10";
iPCIE1.TXN2.$used                                 = false;
iPCIE1.TXN3.$used                                 = false;
iPCIE1.TXP0.$assign                               = "ball.AT8";
iPCIE1.TXP1.$assign                               = "ball.AP11";
iPCIE1.TXP2.$used                                 = false;
iPCIE1.TXP3.$used                                 = false;
const iPCIE2                                      = scripting.addPeripheral("PCIE");
iPCIE2.$name                                      = "MyPCIE0";
iPCIE2.$assign                                    = "PCIE_0";
iPCIE2.REFCLK_N_OUT.$used                         = false;
iPCIE2.REFCLK_P_OUT.$used                         = false;
iPCIE2.CLKREQn.$used                              = false;
iPCIE2.RXN0.$assign                               = "ball.AU5";
iPCIE2.RXN1.$assign                               = "ball.AT4";
iPCIE2.RXN2.$assign                               = "ball.AU2";
iPCIE2.RXN3.$assign                               = "ball.AT1";
iPCIE2.RXP0.$assign                               = "ball.AU6";
iPCIE2.RXP1.$assign                               = "ball.AT5";
iPCIE2.RXP2.$assign                               = "ball.AU3";
iPCIE2.RXP3.$assign                               = "ball.AT2";
iPCIE2.TXN0.$assign                               = "ball.AV6";
iPCIE2.TXN1.$assign                               = "ball.AR5";
iPCIE2.TXN2.$assign                               = "ball.AR2";
iPCIE2.TXN3.$assign                               = "ball.AP1";
iPCIE2.TXP0.$assign                               = "ball.AV7";
iPCIE2.TXP1.$assign                               = "ball.AR6";
iPCIE2.TXP2.$assign                               = "ball.AR3";
iPCIE2.TXP3.$assign                               = "ball.AP2";
const iSERDES1                                    = scripting.addPeripheral("SERDES");
iSERDES1.$name                                    = "MySERDES1";
iSERDES1.$assign                                  = "SERDES_1";
iSERDES1.REFCLK_N.$assign                         = "ball.AV3";
iSERDES1.REFCLK_P.$assign                         = "ball.AV4";
iSERDES1.REXT.$assign                             = "ball.AL9";
const iSERDES2                                    = scripting.addPeripheral("SERDES");
iSERDES2.$name                                    = "MySERDES0";
iSERDES2.$assign                                  = "SERDES_0";
iSERDES2.REFCLK_N.$used                           = false;
iSERDES2.REFCLK_P.$used                           = false;
iSERDES2.REXT.$assign                             = "ball.AN11";
const iSERDES3                                    = scripting.addPeripheral("SERDES");
iSERDES3.$name                                    = "MySERDES2";
iSERDES3.$assign                                  = "SERDES_2";
iSERDES3.REFCLK_N.$used                           = false;
iSERDES3.REFCLK_P.$used                           = false;
iSERDES3.REXT.$assign                             = "ball.AL20";
const iSERDES4                                    = scripting.addPeripheral("SERDES");
iSERDES4.$name                                    = "MySERDES4";
iSERDES4.$assign                                  = "SERDES_4";
iSERDES4.REFCLK_N.$used                           = false;
iSERDES4.REFCLK_P.$used                           = false;
iSERDES4.REXT.$assign                             = "ball.AM19";
const iSYSTEM_VDDSHV01                            = scripting.addPeripheral("SYSTEM_VDDSHV0");
iSYSTEM_VDDSHV01.$name                            = "MySYSTEM_VDDSHV0";
iSYSTEM_VDDSHV01.EXTINTn.$assign                  = "ball.AN35";
iSYSTEM_VDDSHV01.OBSCLK0.$used                    = false;
iSYSTEM_VDDSHV01.RESETSTATz.$assign               = "ball.AL38";
iSYSTEM_VDDSHV01.SOC_SAFETY_ERRORn.$assign        = "ball.AM34";
iSYSTEM_VDDSHV01.SYSCLKOUT0.$used                 = false;
const iSYSTEM_VDDSHV21                            = scripting.addPeripheral("SYSTEM_VDDSHV2");
iSYSTEM_VDDSHV21.$name                            = "MySYSTEM_VDDSHV2";
iSYSTEM_VDDSHV21.$assign                          = "SYSTEM_0_VDDSHV2";
iSYSTEM_VDDSHV21.AUDIO_EXT_REFCLK0.$used          = false;
iSYSTEM_VDDSHV21.AUDIO_EXT_REFCLK1.$used          = false;
iSYSTEM_VDDSHV21.EXT_REFCLK1.$used                = false;
iSYSTEM_VDDSHV21.FCLK_MUX.$used                   = false;
iSYSTEM_VDDSHV21.OBSCLK1.$used                    = false;
iSYSTEM_VDDSHV21.PMIC_WAKE0n.$assign              = "ball.AJ34";
const iUART1                                      = scripting.addPeripheral("UART");
iUART1.$name                                      = "MyUART5";
iUART1.$assign                                    = "USART_5";
iUART1.CTSn.$used                                 = false;
iUART1.DCDn.$used                                 = false;
iUART1.DSRn.$used                                 = false;
iUART1.DTRn.$used                                 = false;
iUART1.RIn.$used                                  = false;
iUART1.RTSn.$used                                 = false;
iUART1.RXD.$assign                                = "ball.AJ33";
iUART1.TXD.$assign                                = "ball.AG36";
const iUART2                                      = scripting.addPeripheral("UART");
iUART2.$name                                      = "MyUART9";
iUART2.$assign                                    = "USART_9";
iUART2.CTSn.$used                                 = false;
iUART2.DCDn.$used                                 = false;
iUART2.DSRn.$used                                 = false;
iUART2.DTRn.$used                                 = false;
iUART2.RIn.$used                                  = false;
iUART2.RTSn.$used                                 = false;
iUART2.RXD.$assign                                = "ball.AC32";
iUART2.TXD.$assign                                = "ball.AC37";
const iUART3                                      = scripting.addPeripheral("UART");
iUART3.$name                                      = "MyUART6";
iUART3.$assign                                    = "USART_6";
iUART3.CTSn.$used                                 = false;
iUART3.DCDn.$used                                 = false;
iUART3.DSRn.$used                                 = false;
iUART3.DTRn.$used                                 = false;
iUART3.RIn.$used                                  = false;
iUART3.RTSn.$used                                 = false;
iUART3.RXD.$assign                                = "ball.AK37";
iUART3.TXD.$assign                                = "ball.AJ37";
const iUART4                                      = scripting.addPeripheral("UART");
iUART4.$name                                      = "MyUART3";
iUART4.$assign                                    = "USART_3";
iUART4.CTSn.$used                                 = false;
iUART4.DCDn.$used                                 = false;
iUART4.DSRn.$used                                 = false;
iUART4.DTRn.$used                                 = false;
iUART4.RIn.$used                                  = false;
iUART4.RTSn.$used                                 = false;
iUART4.RXD.$assign                                = "ball.AC33";
iUART4.TXD.$assign                                = "ball.AH37";
const iUART5                                      = scripting.addPeripheral("UART");
iUART5.$name                                      = "MyUART2";
iUART5.$assign                                    = "USART_2";
iUART5.CTSn.$used                                 = false;
iUART5.DCDn.$used                                 = false;
iUART5.DSRn.$used                                 = false;
iUART5.DTRn.$used                                 = false;
iUART5.RIn.$used                                  = false;
iUART5.RTSn.$used                                 = false;
iUART5.RXD.$assign                                = "ball.AM35";
iUART5.TXD.$assign                                = "ball.AM36";
const iUART6                                      = scripting.addPeripheral("UART");
iUART6.$name                                      = "MyUART8";
iUART6.$assign                                    = "USART_8";
iUART6.CTSn.$assign                               = "ball.AF37";
iUART6.DCDn.$used                                 = false;
iUART6.DSRn.$used                                 = false;
iUART6.DTRn.$used                                 = false;
iUART6.RIn.$used                                  = false;
iUART6.RTSn.$assign                               = "ball.AG37";
iUART6.RXD.$assign                                = "ball.AP38";
iUART6.TXD.$assign                                = "ball.AN38";
const iUFS1                                       = scripting.addPeripheral("UFS");
iUFS1.$name                                       = "MyUFS";
iUFS1.TX_DP0.$assign                              = "ball.AL3";
iUFS1.TX_DN0.$assign                              = "ball.AL2";
iUFS1.RX_DP0.$assign                              = "ball.AM5";
iUFS1.RX_DN0.$assign                              = "ball.AM4";
iUFS1.TX_DP1.$assign                              = "ball.AN3";
iUFS1.TX_DN1.$assign                              = "ball.AN2";
iUFS1.RX_DP1.$assign                              = "ball.AM2";
iUFS1.RX_DN1.$assign                              = "ball.AM1";
iUFS1.RSTn.$assign                                = "ball.AM8";
iUFS1.REF_CLK.$assign                             = "ball.AM7";
const iUSB1                                       = scripting.addPeripheral("USB");
iUSB1.$name                                       = "MyUSB0";
iUSB1.$assign                                     = "USB_0";
iUSB1.DM.$assign                                  = "ball.AP16";
iUSB1.DP.$assign                                  = "ball.AP17";
iUSB1.DRVVBUS.$assign                             = "ball.AN37";
iUSB1.ID.$assign                                  = "ball.AN17";
iUSB1.RCALIB.$assign                              = "ball.AN18";
iUSB1.SSRX1N.$assign                              = "ball.AR11";
iUSB1.SSRX1P.$assign                              = "ball.AR12";
iUSB1.SSRX2N.$assign                              = "ball.AU11";
iUSB1.SSRX2P.$assign                              = "ball.AU12";
iUSB1.SSTX1N.$assign                              = "ball.AV9";
iUSB1.SSTX1P.$assign                              = "ball.AV10";
iUSB1.SSTX2N.$assign                              = "ball.AV12";
iUSB1.SSTX2P.$assign                              = "ball.AV13";
iUSB1.VBUS.$assign                                = "ball.AN15";
const iWKUP_GPIO_VDDSHV0_MCU1                     = scripting.addPeripheral("WKUP_GPIO_VDDSHV0_MCU");
iWKUP_GPIO_VDDSHV0_MCU1["0"].$assign              = "ball.H38";
iWKUP_GPIO_VDDSHV0_MCU1["1"].$assign              = "ball.J34";
iWKUP_GPIO_VDDSHV0_MCU1["2"].$assign              = "ball.J35";
iWKUP_GPIO_VDDSHV0_MCU1["3"].$assign              = "ball.J36";
iWKUP_GPIO_VDDSHV0_MCU1["4"].$used                = false;
iWKUP_GPIO_VDDSHV0_MCU1["5"].$used                = false;
iWKUP_GPIO_VDDSHV0_MCU1["6"].$assign              = "ball.L37";
iWKUP_GPIO_VDDSHV0_MCU1["7"].$assign              = "ball.L36";
iWKUP_GPIO_VDDSHV0_MCU1["8"].$used                = false;
iWKUP_GPIO_VDDSHV0_MCU1["9"].$used                = false;
iWKUP_GPIO_VDDSHV0_MCU1["10"].$used               = false;
iWKUP_GPIO_VDDSHV0_MCU1["11"].$used               = false;
iWKUP_GPIO_VDDSHV0_MCU1["12"].$used               = false;
iWKUP_GPIO_VDDSHV0_MCU1["13"].$used               = false;
iWKUP_GPIO_VDDSHV0_MCU1["14"].$used               = false;
iWKUP_GPIO_VDDSHV0_MCU1["15"].$used               = false;
iWKUP_GPIO_VDDSHV0_MCU1["49"].$used               = false;
iWKUP_GPIO_VDDSHV0_MCU1["54"].$assign             = "ball.G38";
iWKUP_GPIO_VDDSHV0_MCU1["55"].$assign             = "ball.H36";
iWKUP_GPIO_VDDSHV0_MCU1["56"].$assign             = "ball.M37";
iWKUP_GPIO_VDDSHV0_MCU1["57"].$assign             = "ball.M36";
iWKUP_GPIO_VDDSHV0_MCU1["58"].$used               = false;
iWKUP_GPIO_VDDSHV0_MCU1["59"].$used               = false;
iWKUP_GPIO_VDDSHV0_MCU1["60"].$used               = false;
iWKUP_GPIO_VDDSHV0_MCU1["61"].$used               = false;
iWKUP_GPIO_VDDSHV0_MCU1["63"].$used               = false;
iWKUP_GPIO_VDDSHV0_MCU1["64"].$used               = false;
iWKUP_GPIO_VDDSHV0_MCU1["65"].$used               = false;
iWKUP_GPIO_VDDSHV0_MCU1["66"].$assign             = "ball.N34";
iWKUP_GPIO_VDDSHV0_MCU1["67"].$used               = false;
iWKUP_GPIO_VDDSHV0_MCU1["68"].$used               = false;
iWKUP_GPIO_VDDSHV0_MCU1["69"].$assign             = "ball.J38";
iWKUP_GPIO_VDDSHV0_MCU1["70"].$assign             = "ball.F37";
iWKUP_GPIO_VDDSHV0_MCU1["87"].$used               = false;
iWKUP_GPIO_VDDSHV0_MCU1["88"].$used               = false;
iWKUP_GPIO_VDDSHV0_MCU1.$name                     = "MyWKUP_GPIO_VDDSHV0_MCU";
iWKUP_GPIO_VDDSHV0_MCU1.$assign                   = "WKUP_GPIO_0_VDDSHV0_MCU";
const iWKUP_GPIO_VDDSHV1_MCU1                     = scripting.addPeripheral("WKUP_GPIO_VDDSHV1_MCU");
iWKUP_GPIO_VDDSHV1_MCU1["16"].$used               = false;
iWKUP_GPIO_VDDSHV1_MCU1["17"].$used               = false;
iWKUP_GPIO_VDDSHV1_MCU1["18"].$used               = false;
iWKUP_GPIO_VDDSHV1_MCU1["19"].$used               = false;
iWKUP_GPIO_VDDSHV1_MCU1["20"].$used               = false;
iWKUP_GPIO_VDDSHV1_MCU1["21"].$used               = false;
iWKUP_GPIO_VDDSHV1_MCU1["22"].$used               = false;
iWKUP_GPIO_VDDSHV1_MCU1["23"].$used               = false;
iWKUP_GPIO_VDDSHV1_MCU1["24"].$used               = false;
iWKUP_GPIO_VDDSHV1_MCU1["25"].$used               = false;
iWKUP_GPIO_VDDSHV1_MCU1["26"].$used               = false;
iWKUP_GPIO_VDDSHV1_MCU1["27"].$used               = false;
iWKUP_GPIO_VDDSHV1_MCU1["28"].$assign             = "ball.A33";
iWKUP_GPIO_VDDSHV1_MCU1["29"].$used               = false;
iWKUP_GPIO_VDDSHV1_MCU1["30"].$used               = false;
iWKUP_GPIO_VDDSHV1_MCU1["31"].$used               = false;
iWKUP_GPIO_VDDSHV1_MCU1["32"].$used               = false;
iWKUP_GPIO_VDDSHV1_MCU1["33"].$used               = false;
iWKUP_GPIO_VDDSHV1_MCU1["34"].$used               = false;
iWKUP_GPIO_VDDSHV1_MCU1["35"].$used               = false;
iWKUP_GPIO_VDDSHV1_MCU1["36"].$used               = false;
iWKUP_GPIO_VDDSHV1_MCU1["37"].$used               = false;
iWKUP_GPIO_VDDSHV1_MCU1["38"].$used               = false;
iWKUP_GPIO_VDDSHV1_MCU1["39"].$assign             = "ball.G33";
iWKUP_GPIO_VDDSHV1_MCU1.$name                     = "MyWKUP_GPIO_VDDSHV1_MCU";
iWKUP_GPIO_VDDSHV1_MCU1.$assign                   = "WKUP_GPIO_0_VDDSHV1_MCU";
const iWKUP_I2C1                                  = scripting.addPeripheral("WKUP_I2C");
iWKUP_I2C1.$name                                  = "MyWKUP_I2C0";
iWKUP_I2C1.SCL.$assign                            = "ball.N33";
iWKUP_I2C1.SDA.$assign                            = "ball.N35";
const iWKUP_JTAG_VDDSHV0_MCU1                     = scripting.addPeripheral("WKUP_JTAG_VDDSHV0_MCU");
iWKUP_JTAG_VDDSHV0_MCU1.$name                     = "MyWKUP_JTAG_VDDSHV0_MCU";
iWKUP_JTAG_VDDSHV0_MCU1.EMU0.$assign              = "ball.F35";
iWKUP_JTAG_VDDSHV0_MCU1.EMU1.$assign              = "ball.H34";
iWKUP_JTAG_VDDSHV0_MCU1.TCK.$assign               = "ball.G35";
iWKUP_JTAG_VDDSHV0_MCU1.TRSTn.$assign             = "ball.G37";
const iWKUP_OSC1                                  = scripting.addPeripheral("WKUP_OSC");
iWKUP_OSC1.$name                                  = "MyWKUP_OSC0";
iWKUP_OSC1.XI.$assign                             = "ball.T38";
iWKUP_OSC1.XO.$assign                             = "ball.U37";
const iWKUP_SYSTEM_MCU1                           = scripting.addPeripheral("WKUP_SYSTEM_MCU");
iWKUP_SYSTEM_MCU1.$name                           = "MyWKUP_SYSTEM_MCU";
iWKUP_SYSTEM_MCU1.$assign                         = "WKUP_SYSTEM_0_MCU";
iWKUP_SYSTEM_MCU1.LF_CLKIN.$assign                = "ball.M34";
iWKUP_SYSTEM_MCU1.MCU_CLKOUT0.$used               = false;
iWKUP_SYSTEM_MCU1.MCU_EXT_REFCLK0.$used           = false;
iWKUP_SYSTEM_MCU1.MCU_OBSCLK0.$used               = false;
iWKUP_SYSTEM_MCU1.MCU_RESETSTATz.$assign          = "ball.F36";
iWKUP_SYSTEM_MCU1.MCU_RESETz.$assign              = "ball.G36";
iWKUP_SYSTEM_MCU1.MCU_SYSCLKOUT0.$used            = false;
iWKUP_SYSTEM_MCU1.PMIC_POWER_EN1.$assign          = "ball.L38";
iWKUP_SYSTEM_MCU1.RESET_REQz.$assign              = "ball.F34";
iWKUP_SYSTEM_MCU1.PMIC_WAKE1n.$assign             = "ball.M33";
iWKUP_SYSTEM_MCU1.MCU_ADC_EXT_TRIGGER0.$assign    = "ball.L33";
iWKUP_SYSTEM_MCU1.MCU_ADC_EXT_TRIGGER1.$used      = false;
const iWKUP_SYSTEM_VDDA_WKUP1                     = scripting.addPeripheral("WKUP_SYSTEM_VDDA_WKUP");
iWKUP_SYSTEM_VDDA_WKUP1.$name                     = "MyWKUP_SYSTEM_VDDA_WKUP";
iWKUP_SYSTEM_VDDA_WKUP1.$assign                   = "WKUP_SYSTEM_0_VDDA_WKUP";
iWKUP_SYSTEM_VDDA_WKUP1.MCU_PORz.$assign          = "ball.K32";
iWKUP_SYSTEM_VDDA_WKUP1.MCU_SAFETY_ERRORn.$assign = "ball.N36";
iWKUP_SYSTEM_VDDA_WKUP1.PORz.$assign              = "ball.P33";
const iWKUP_UART1                                 = scripting.addPeripheral("WKUP_UART");
iWKUP_UART1.$name                                 = "MyWKUP_UART0";
iWKUP_UART1.$assign                               = "WKUP_USART_0";
iWKUP_UART1.CTSn.$used                            = false;
iWKUP_UART1.RTSn.$used                            = false;
iWKUP_UART1.RXD.$assign                           = "ball.K35";
iWKUP_UART1.TXD.$assign                           = "ball.K34";

/**
 * Pinmux solution for unlocked pins/peripherals. This ensures that minor changes to the automatic solver in a future
 * version of the tool will not impact the pinmux you originally saw.  These lines can be completely deleted in order to
 * re-solve from scratch.
 */
iAUXPHY1.$suggestSolution                = "AUXPHY_0";
iCPSW2G1.$suggestSolution                = "CPSW2G_0";
iCPSW9X1.$suggestSolution                = "CPSW9X_0";
iCSI1.$suggestSolution                   = "CSI_RX_0";
iCSI2.$suggestSolution                   = "CSI_RX_1";
iCSI3.$suggestSolution                   = "CSI_RX_2";
iDDRSS1.$suggestSolution                 = "DDR_0";
iDDRSS1.DQ21.$suggestSolution            = "ball.AF4";
iDDRSS2.$suggestSolution                 = "DDR_1";
iDDRSS3.$suggestSolution                 = "DDR_2";
iDDRSS4.$suggestSolution                 = "DDR_3";
iDP1.$suggestSolution                    = "DP_0";
iDSI1.$suggestSolution                   = "DSI_TX_0";
iGPIO_VDDSHV21.$suggestSolution          = "GPIO_0_VDDSHV2";
iI2C5.$suggestSolution                   = "I2C_0";
iJTAG_VDDSHV01.$suggestSolution          = "JTAG_VDDSHV0";
iMCU_ADC1.$suggestSolution               = "MCU_ADC_0";
iMCU_CPSW2G1.$suggestSolution            = "MCU_CPSW2G_0";
iMCU_MDIO1.$suggestSolution              = "MCU_MDIO_0";
iMCU_OSPI1.$suggestSolution              = "MCU_OSPI_0";
iPCIE1.REFCLK_P_OUT.$suggestSolution     = "ball.AN9";
iSYSTEM_VDDSHV01.$suggestSolution        = "SYSTEM_0_VDDSHV0";
iUFS1.$suggestSolution                   = "UFS_0";
iWKUP_I2C1.$suggestSolution              = "WKUP_I2C_0";
iWKUP_JTAG_VDDSHV0_MCU1.$suggestSolution = "WKUP_JTAG";
iWKUP_OSC1.$suggestSolution              = "WKUP_OSC_0";
